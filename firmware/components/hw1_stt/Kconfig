## firmware/components/hw1_stt/Kconfig
```kconfig
menu "HardwareOne standalone STT"
config HW1_STT_MODEL_LOCAL_PREPARE
    bool "Use model-local prepared arguments (experimental)"
    default n
    help
        Prepare each model through its own module objects. Normal execution in
        another model never consults the recognition worker's preparation flag.
        Non-Conv operators do no arithmetic during preparation. Requires the
        isolated and concurrent-model qualification; does not change weights.
        All ESP-DL modules/callers must be rebuilt with the same setting; this
        adds a virtual preparation entry point. A single model still requires
        one execution owner; this does not make that model safe for reentry.
endmenu
```

## firmware/examples/p4_eye_captions/main/Kconfig.projbuild
```kconfig
menu "Standalone captions streaming"
config CAPTIONS_STREAM_METRICS
    bool "Collect bounded streaming lock and capture diagnostics"
    default n
    help
        Adds operation timing, memory-traffic counters and I2S loss counters.
        Use the USB command perf dump between test inputs. Results are emitted
        outside the streaming lock. This changes timing and needs overhead controls.
config CAPTIONS_CAPTURE_FEATURES
    bool "Compute reusable features during capture"
    default y
config CAPTIONS_CLEAR_COMMITTED_FEATURES
    bool "Clear only committed feature-cache rows (experimental)"
    depends on CAPTIONS_CAPTURE_FEATURES
    default n
    help
        Preserve initial whole-pool clearing, then clear the complete written
        prefix on retirement. Reader pins and generation checks remain intact.
        Requires the capture-lock qualification described in the project plan.
config CAPTIONS_DRAFTS
    bool "Publish preemptible live drafts"
    default y
config CAPTIONS_X2F_DRAFT_PACING
    bool "Use x2 compute-paced drafts with a fast first draft (experimental)"
    depends on CAPTIONS_DRAFTS
    default n
    help
        Keep a one-second audio floor for the first preview, then require
        at least 600 ms of new audio or twice the previous draft compute time.
        A new phrase does not inherit a slow previous phrase's draft delay.
        Requires standalone device latency/accuracy qualification.
config CAPTIONS_TRIM_SILENCE
    bool "Retain 500 ms of trailing silence (requires audio qualification)"
    default n
config CAPTIONS_SPECULATIVE_FINAL
    bool "Compute exact speculative finals before segment closure"
    depends on CAPTIONS_TRIM_SILENCE
    default y
endmenu
```

## tools/device_tests/stream/p4_precision/main/Kconfig.projbuild
```kconfig
rsource "../../../../../firmware/examples/p4_eye_captions/main/Kconfig.projbuild"
```
